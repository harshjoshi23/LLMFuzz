## targets/bms-firmware/app/boards/bms_5s50_sc.conf
```kconfig
# Copyright (c) The Libre Solar Project Contributors
# SPDX-License-Identifier: Apache-2.0

CONFIG_EEPROM=y
CONFIG_EEPROM_AT24=y

# MCU does not have sufficient RAM
CONFIG_THINGSET_CAN=n
```

## targets/bms-firmware/west.yml
```yaml
# SPDX-License-Identifier: Apache-2.0

manifest:
  remotes:
    - name: zephyrproject
      url-base: https://github.com/zephyrproject-rtos
    - name: libresolar
      url-base: https://github.com/LibreSolar
    - name: thingset
      url-base: https://github.com/ThingSet
    - name: throwtheswitch
      url-base: https://github.com/ThrowTheSwitch
  projects:
    - name: zephyr
      remote: zephyrproject
      revision: v4.3-branch
      import:
        name-allowlist:
          - cmsis_6
          - edtt
          - hal_espressif
          - hal_stm32
          - mbedtls
          - mcuboot
          - tinycrypt
          - zcbor
    - name: thingset-zephyr-sdk
      remote: thingset
      revision: 9784e05914a7b3270802c84c10f52a640c823348
      path: thingset-zephyr-sdk
      import:
        name-allowlist:
          - thingset-node-c
          - zcbor
```

## targets/charge-controller-firmware/boards/libresolar/mppt_1210_hus/Kconfig.mppt_1210_hus
```kconfig
# Copyright (c) The Libre Solar Project Contributors
# SPDX-License-Identifier: Apache-2.0

config BOARD_MPPT_1210_HUS
	select SOC_STM32L072XX
```

## targets/charge-controller-firmware/boards/libresolar/mppt_1210_hus/board.yml
```yaml
board:
  name: mppt_1210_hus
  vendor: libresolar
  socs:
    - name: stm32l072xx
  revision:
    format: major.minor.patch
    default: "0.7.0"
    revisions:
      - name: "0.4.0"
      - name: "0.7.0"
```

## targets/charge-controller-firmware/boards/libresolar/mppt_2420_hpx/Kconfig.mppt_2420_hpx
```kconfig
# Copyright (c) The Libre Solar Project Contributors
# SPDX-License-Identifier: Apache-2.0

config BOARD_MPPT_2420_HPX
	select SOC_STM32G431XX
```

## targets/charge-controller-firmware/boards/libresolar/mppt_2420_hpx/board.yml
```yaml
board:
  name: mppt_2420_hpx
  vendor: libresolar
  socs:
    - name: stm32g431xx
```

## targets/charge-controller-firmware/boards/libresolar/mppt_2420_lc/Kconfig.mppt_2420_lc
```kconfig
# Copyright (c) The Libre Solar Project Contributors
# SPDX-License-Identifier: Apache-2.0

config BOARD_MPPT_2420_LC
	select SOC_STM32F072XB
```

## targets/charge-controller-firmware/boards/libresolar/mppt_2420_lc/board.yml
```yaml
board:
  name: mppt_2420_lc
  vendor: libresolar
  socs:
    - name: stm32f072xb
```

## targets/charge-controller-firmware/boards/libresolar/mppt_2420_lc/mppt_2420_lc_defconfig
```kconfig
# SPDX-License-Identifier: Apache-2.0

CONFIG_CLOCK_CONTROL=y

CONFIG_PINCTRL=y

CONFIG_GPIO=y

CONFIG_SERIAL=y

CONFIG_CONSOLE=y
CONFIG_UART_CONSOLE=y

CONFIG_I2C=y
CONFIG_EEPROM=y
CONFIG_EEPROM_AT24=y

# too little RAM, can only be enabled if serial is disabled
#CONFIG_CAN=y
#CONFIG_THINGSET_CAN=y
```

## targets/charge-controller-firmware/boards/libresolar/mppt_2420_rc/board.yml
```yaml
board:
  name: mppt_2420_rc
  vendor: libresolar
  socs:
    - name: stm32f072xb
```

## targets/charge-controller-firmware/boards/libresolar/pwm_2420_lus/Kconfig.pwm_2420_lus
```kconfig
# Copyright (c) The Libre Solar Project Contributors
# SPDX-License-Identifier: Apache-2.0

config BOARD_PWM_2420_LUS
	select SOC_STM32L072XX
```

## targets/charge-controller-firmware/boards/libresolar/pwm_2420_lus/board.yml
```yaml
board:
  name: pwm_2420_lus
  vendor: libresolar
  socs:
    - name: stm32l072xx
  revision:
    format: major.minor.patch
    default: "0.3.0"
    revisions:
      - name: "0.2.0"
      - name: "0.3.0"
```

## targets/charge-controller-firmware/west.yml
```yaml
manifest:
  remotes:
    - name: zephyrproject
      url-base: https://github.com/zephyrproject-rtos
    - name: libresolar
      url-base: https://github.com/LibreSolar
    - name: thingset
      url-base: https://github.com/ThingSet
    - name: throwtheswitch
      url-base: https://github.com/ThrowTheSwitch
  projects:
    - name: zephyr
      remote: zephyrproject
      revision: v4.3-branch
      import:
        name-allowlist:
          - cmsis_6
          - edtt
          - hal_stm32
          - zcbor
    - name: oled-display-library
      remote: libresolar
      revision: 523b26c103de56714fcda655702d600870a671bc
      path: modules/oled-display
    - name: thingset-zephyr-sdk
      remote: thingset
      revision: 5d5c6b031ba543d67a3dc6904ccfc987ebdadc52
      path: thingset-zephyr-sdk
      import:
        name-allowlist:
          - thingset-node-c
          - zcbor
    - name: unity
      remote: throwtheswitch
      revision: 74cde089e65c3435ce9aa87d5c69f4f16b7f6ade
      path: modules/unity
```
